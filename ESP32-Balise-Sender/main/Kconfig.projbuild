## ESP32-Balise-Sender/main/Kconfig.projbuild
```kconfig
# vim:et:sts=4:sw=4:si
menu "Beacon Configuration"
    menu "Beacon ID"
        config BEACON_ID_BUILDER
            string "Device Builder ID (3 chars)"
            default "000"
            help
              Should be a registered 3 char [A-Z][0-9] string only!!
        
        config BEACON_ID_VERSION
            string "Device Version (3 chars)"
            default "AM1"
            help
              Should be a 3 char [0-9] string only!!
    
        config BEACON_ID_GROUP_MSB_IO
            int "Model Group MSB GPIO number"
            range 0 34
            default 26
            help
                GPIO number (IOxx) to use

        config BEACON_ID_GROUP_LSB_IO
            int "Model Group LSB GPIO number"
            range 0 34
            default 27
            help
                GPIO number (IOxx) to use

        config BEACON_ID_MASS_MSB_IO
            int "Model Weigh Class MSB GPIO number"
            range 0 34
            default 14
            help
                GPIO number (IOxx) to use

        config BEACON_ID_MASS_LSB_IO
            int "Model Weigh Class LSB GPIO number"
            range 0 34
            default 25
            help
                GPIO number (IOxx) to use
        
    endmenu
    menu "GPS configuration"
        choice BEACON_GPS_MODEL
            prompt "GPS Model"
            default BEACON_GPS_BN_220_UART
            help
                The type of GPS module connected to the beacon

            config BEACON_GPS_MOCK
                bool "Mock (not a real device)"
                help
                    Useful to send beacons every 3 seconds, even if no device
            config BEACON_GPS_BN_220_UART
                bool "BN-220 (UART preconfigured in 115200)"
                help
                    Must be preconfigured in 115200 bauds and to send only GNRMC and GNGGA NMEA
                    messages
            config BEACON_GPS_L80R_UART
                bool "L80R (UART, dynamicaly configured)"
                help
                    Quectel L80-R GPS

                    Will be auto-configured at boot time
            config BEACON_GPS_L96_UART
                bool "L96 (UART, preconfigured in 115200)"
                help
                    Quectel L96 GPS using PPS + UART

                    Must be preconfigured in 115200 bauds with PPS enabled (140ms long peaks)
            config BEACON_GPS_L96_I2C
                bool "L96 (I2C)"
                help
                    Quectel L96 GPS using I2C port
        endchoice
        config BEACON_GPS_SDA_IO
            int "GPS SDA GPIO number" if BEACON_GPS_L96_I2C
            range 0 34
            default 16
            help
                GPIO number (IOxx) to use for I2C Data

        config BEACON_GPS_SCL_IO
            int "GPS SCL GPIO number" if BEACON_GPS_L96_I2C
            range 0 34
            default 17
            help
                GPIO number (IOxx) to use for I2C Clock

        config BEACON_GPS_PPS_IO
            int "GPS PPS GPIO number" if BEACON_GPS_L80R_UART || BEACON_GPS_L96_UART
            range 0 34
            default 4
            help
                GPIO number (IOxx) to use to recieve PPS signal from GPS
    endmenu

    config BEACON_WIFI_CHANNEL
        int "WIFI Channel for beacon"
        range 1 14
        default 6
        help
            Use 6 by default

endmenu
```

## main/Kconfig.projbuild
```kconfig
# vim:et:sts=4:sw=4:si
menu "Beacon Configuration"
    menu "Beacon ID"
        config BEACON_ID_BUILDER
            string "Device Builder ID (3 chars)"
            default "000"
            help
              Should be a registered 3 char [A-Z][0-9] string only!!
        
        config BEACON_ID_VERSION
            string "Device Version (3 chars)"
            default "AM1"
            help
              Should be a 3 char [0-9] string only!!
    
        config BEACON_ID_GROUP_MSB_IO
            int "Model Group MSB GPIO number"
            range 0 34
            default 26
            help
                GPIO number (IOxx) to use

        config BEACON_ID_GROUP_LSB_IO
            int "Model Group LSB GPIO number"
            range 0 34
            default 27
            help
                GPIO number (IOxx) to use

        config BEACON_ID_MASS_MSB_IO
            int "Model Weigh Class MSB GPIO number"
            range 0 34
            default 14
            help
                GPIO number (IOxx) to use

        config BEACON_ID_MASS_LSB_IO
            int "Model Weigh Class LSB GPIO number"
            range 0 34
            default 25
            help
                GPIO number (IOxx) to use
        
    endmenu
    menu "GPS configuration"
        config BEACON_GPS_PPS_IO
            int "GPS PPS GPIO number"
            range 0 34
            default 4
            help
                GPIO number (IOxx) to use to recieve PPS signal from GPS
    endmenu

    config BEACON_WIFI_CHANNEL
        int "WIFI Channel for beacon"
        range 1 14
        default 6
        help
            Use 6 by default

endmenu
```
